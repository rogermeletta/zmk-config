## config/west.yml
```yaml
manifest:
  remotes:
    # - name: zmkfirmware
    #   url-base: https://github.com/zmkfirmware
    # - name: krikun98
    #   url-base: https://github.com/krikun98
    # - name: ftc
    #   url-base: https://github.com/ftc
    - name: vesim
      url-base: https://github.com/vesim987
  projects:
    - name: zmk
      remote: vesim
      revision: mouse-ftc
      import: app/west.yml
  self:
    path: config
```
